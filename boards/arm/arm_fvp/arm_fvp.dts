/*
 * Copyright (c) 2019 Carlo Caione <ccaione@baylibre.com>
 *
 * SPDX-License-Identifier: Apache-2.0
 *
 */

/dts-v1/;
#include <arm/arm_fvp/arm_fvp.dtsi>

/ {
	model = "FVP Foundation";
	compatible = "arm,fvp-base", "arm,vexpress";

	chosen {
		/* zephyr,console = &uart0; */
		/* zephyr,shell-uart = &uart0; */
		/* zephyr,flash = &flash0; */
	};
};

&uart0 {
	/* status = "okay"; */
	current-speed = <115200>;
};
