## boards/arm/arm_fvp/Kconfig.board
```kconfig
# Copyright (c) 2019 Carlo Caione <ccaione@baylibre.com>
# SPDX-License-Identifier: Apache-2.0

config BOARD_ARM_FVP
	bool "ARM FVP board"
	depends on SOC_ARM_FVP
	select ARM64
```

## boards/arm/arm_fvp/Kconfig.defconfig
```kconfig
# Copyright (c) 2019 Carlo Caione <ccaione@baylibre.com>
# SPDX-License-Identifier: Apache-2.0

if BOARD_ARM_FVP

config BUILD_OUTPUT_BIN
	default y

config BOARD
	default "arm_fvp"

endif # BOARD_ARM_FVP
```

## boards/arm/arm_fvp/arm_fvp_defconfig
```kconfig
CONFIG_SOC_ARM_FVP=y
CONFIG_BOARD_ARM_FVP=y
CONFIG_ARM_ARCH_TIMER=y
CONFIG_XIP=n

# QEMU settings
CONFIG_SRAM_BASE_ADDRESS=0x37200000
CONFIG_SRAM_SIZE=2048

# Enable UART driver
# CONFIG_SERIAL is not set
# CONFIG_SHARED_IRQ is not set

# Enable console
# CONFIG_CONSOLE is not set
# CONFIG_UART_CONSOLE is not set

# Enable serial port
# CONFIG_UART_PL011 is not set
# CONFIG_UART_PL011_PORT0 is not set
# CONFIG_UART_INTERRUPT_DRIVEN is not set
# CONFIG_SHARED_IRQ_0 is not set
# CONFIG_UART_PL011_PORT0_SHARED_IRQ is not set

CONFIG_NO_OPTIMIZATIONS=y

CONFIG_MINOS=y
CONFIG_DYNAMIC_INTERRUPTS=y

CONFIG_SHELL=y
CONFIG_SHELL_BACKEND_SERIAL=n
CONFIG_SHELL_BACKEND_VM=y
CONFIG_KERNEL_SHELL=y
CONFIG_DEVICE_SHELL=y
```

## drivers/minos/Kconfig
```kconfig
# Minos hypervisor driver configuration options
#
# Copyright (c) 2019 Le Min
# SPDX-License-Identifier: Apache-2.0

menuconfig MINOS
	bool "Minos Hypervisor Driver"
	depends on ARM64
	help
	  Include Minos hypervisor driver in system config

module = MINOS
module-str = minos
source "subsys/logging/Kconfig.template.log_config"
```

## dts/bindings/minos/minos,vm_console.yaml
```yaml
# Copyright (c) 2019, Le Min
# SPDX-License-Identifier: Apache-2.0

description: This is a representation of Minos vm debug console

compatible: "minos,vm_console"

include: base.yaml

properties:
        reg:
          required: true

        label:
          required: true
```

## dts/bindings/minos/minos,vmbox.yaml
```yaml
# Copyright (c) 2019, Le Min
# SPDX-License-Identifier: Apache-2.0

description: This is a representation of Minos vmbox controller

compatible: "minos,vmbox-controller"

include: base.yaml

properties:
        reg:
          required: true

        interrupts:
          required: true

        label:
          required: true
```

## dts/bindings/vmbox/minos,vmbox.yaml
```yaml
# Copyright (c) 2019, Le Min
# SPDX-License-Identifier: Apache-2.0

title: Minos vmbox controller driver

description: |
        This is a representation of Minos vmbox controller

compatible: "minos,vmbox-controller"

include: base.yaml

properties:
        reg:
          required: true

        interrupts:
          required: true

        label:
          required: true
```
